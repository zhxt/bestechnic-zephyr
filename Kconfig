## Kconfig
```kconfig
# Copyright The Zephyr Project Contributors
# SPDX-License-Identifier: Apache-2.0

rsource "bsp/drivers/mbox/Kconfig"
rsource "bsp/drivers/serial/Kconfig"
rsource "bsp/drivers/gpio/Kconfig"

config BES2700YP_GPIO_VALIDATION
	int "Restricted GPIO qualification mode"
	range 0 2
	default 0
	help
	  Selected by the fixed validation profile: 1 enables P2_0/P2_1
	  polling, 2 additionally drives P1_4. Output requires compatible
	  board IO/LED voltage. Standard API profiles use the
	  restricted BTH GPIO driver.

config BES2700YP_GPIO_IRQ_VALIDATION
	bool "Interactive GPIO IRQ qualification"
	default n
	help
	  Validation-only sequencing: the M55 message worker waits for BTH to
	  publish its first message state. The heartbeat remains active while
	  the operator provides pre-restart GPIO evidence. Traffic deadlines
	  start only after this bounded interaction and retain their limits.
```

## bsp/boards/bestechnic/bes2700yp_devkit/Kconfig.bes2700yp_devkit
```kconfig
# SPDX-License-Identifier: Apache-2.0

config BOARD_BES2700YP_DEVKIT
	select SOC_BES2700YP_CM55 if BOARD_BES2700YP_DEVKIT_BES2700YP_CM55
	select SOC_BES2700YP_BTH if BOARD_BES2700YP_DEVKIT_BES2700YP_BTH
```

## bsp/boards/bestechnic/bes2700yp_devkit/bes2700yp_devkit_bes2700yp_bth_defconfig
```kconfig
# SPDX-License-Identifier: Apache-2.0
CONFIG_ARM_MPU=n
CONFIG_FPU=n
CONFIG_XIP=y
CONFIG_INIT_ARCH_HW_AT_BOOT=y
CONFIG_SERIAL=n
CONFIG_CONSOLE=n
CONFIG_PRINTK=n
CONFIG_MAIN_STACK_SIZE=2048
```

## bsp/boards/bestechnic/bes2700yp_devkit/bes2700yp_devkit_bes2700yp_cm55_defconfig
```kconfig
# SPDX-License-Identifier: Apache-2.0

CONFIG_ARM_MPU=y
CONFIG_HW_STACK_PROTECTION=y
CONFIG_FPU=y

CONFIG_PRINTK=y
CONFIG_CONSOLE=n
CONFIG_SERIAL=n

CONFIG_MAIN_STACK_SIZE=2048
```

## bsp/boards/bestechnic/bes2700yp_devkit/board.yml
```yaml
board:
  name: bes2700yp_devkit
  full_name: BES2700YP Development Kit
  vendor: bestechnic
  socs:
    - name: bes2700yp
```

## bsp/drivers/gpio/Kconfig
```kconfig
# SPDX-License-Identifier: Apache-2.0
config GPIO_BES2700YP
	bool "BES2700YP GPIO through the BTH resource service"
	default y
	depends on GPIO && SOC_BES2700YP_BTH && !USERSPACE
	depends on DT_HAS_BESTECHNIC_BES2700YP_GPIO_ENABLED
	help
	  Restricted GPIO: P2_0/P2_1 input pull-up and optional P1_4
	  push-pull output. Calls require an IRQ-enabled privileged BTH thread.
	  The boot service must already provide the GPIO capability. Device
	  initialization only discovers it; applications configure pins after
	  M55 launch. GPIO hogs and init-time consumers are unsupported.

config GPIO_BES2700YP_IRQ
	bool "P2_0/P2_1 edge interrupts through the BTH PSC/AON service"
	depends on GPIO_BES2700YP
	help
	  Enable single-edge interrupts and callbacks on the two input keys.
	  Both-edge, level-triggered interrupts and wakeup are unsupported.
	  Configuration requires a privileged IRQ-enabled thread; a callback
	  may disable its pin. Unknown AON sources and storms quarantine IRQ 44.
```

## bsp/drivers/mbox/Kconfig
```kconfig
# Copyright The Zephyr Project Contributors
# SPDX-License-Identifier: Apache-2.0

config MBOX_BES2700
	bool "BES2700 SYS to BTH doorbell"
	default y
	depends on MBOX
	depends on SOC_BES2700YP_CM55 || SOC_BES2700YP_BTH
	depends on DT_HAS_BESTECHNIC_BES2700_MBOX_ENABLED
	help
	  Signalling-only SYS/BTH mailbox using hardware channel 1. Logical channel
	  0 is exposed to clients. Hardware channel 0 remains owned by the loader.
	  Repeated sends while busy coalesce into one pending notification.
```

## bsp/drivers/serial/Kconfig
```kconfig
# SPDX-License-Identifier: Apache-2.0
config UART_BES2700
	bool "BES2700 BTH UART (boot adapter clock and pins)"
	default y
	depends on DT_HAS_BESTECHNIC_BES2700_BTH_UART_ENABLED
	depends on SERIAL && SOC_BES2700YP_BTH
	select SERIAL_HAS_DRIVER
	select SERIAL_SUPPORT_INTERRUPT
	help
	  Fixed 8N1 UART using the clock and pinmux prepared by the BTH boot
	  adapter. Supports polling and interrupt API, not DMA or clock gating.
```

## bsp/dts/bindings/gpio/bestechnic,bes2700yp-gpio.yaml
```yaml
# SPDX-License-Identifier: Apache-2.0
description: |
  BES2700YP AON GPIO accessed through the privileged BTH resource service.
  The inherited bank clock/reset are required; the driver does not manage
  them or claim arbitrary pads. Pin numbers use bank * 8 + offset:
  16/17 are P2_0/P2_1 input pull-up, 12 is optional P1_4 push-pull output.
  Use gpio-reserved-ranges to exclude every other pin. Configuration is
  deferred until M55 is running or held by the lifecycle service. IRQs,
  GPIO hogs and automatic consumers configured during boot are unsupported.
compatible: "bestechnic,bes2700yp-gpio"
include: [base.yaml, gpio-controller.yaml]
properties:
  reg:
    required: true
  "#gpio-cells":
    const: 2
  ngpios:
    const: 18
  gpio-reserved-ranges:
    required: true
gpio-cells:
  - pin
  - flags
```

## bsp/dts/bindings/mbox/bestechnic,bes2700-mbox.yaml
```yaml
# Copyright The Zephyr Project Contributors
# SPDX-License-Identifier: Apache-2.0

description: |
  BES2700 SYS to BTH signalling mailbox. This instance owns hardware
  channel 1 only, exposed as logical channel 0. Hardware channel 0 is reserved
  for the vendor loader. Register windows contain only SET and CLR registers;
  reg-names are sys and bth. Interrupt names are rx and tx-done on the selected local endpoint.

compatible: "bestechnic,bes2700-mbox"

include: [base.yaml, mailbox-controller.yaml]

properties:
  endpoint-bth:
    type: boolean
    description: Select the BTH local register and interrupt layout.
  reg:
    required: true
  reg-names:
    required: true
  interrupts:
    required: true
  interrupt-names:
    required: true
  "#mbox-cells":
    const: 1

mbox-cells:
  - channel
```

## bsp/dts/bindings/serial/bestechnic,bes2700-bth-uart.yaml
```yaml
# SPDX-License-Identifier: Apache-2.0
description: |
  BES2700 BTH UART with PL011-style registers and BES RXEXT/OVSAMP.
  The boot adapter must enable the clock and configure the pins before init.
  This initial driver supports fixed 8N1 with no flow control.
compatible: "bestechnic,bes2700-bth-uart"
include: uart-controller.yaml
properties:
  reg:
    required: true
  interrupts:
    required: true
  clock-frequency:
    required: true
  current-speed:
    required: true
  parity:
    const: "none"
  stop-bits:
    const: "1"
  data-bits:
    const: 8
```

## bsp/soc/bestechnic/bes2700yp/Kconfig
```kconfig
# SPDX-License-Identifier: Apache-2.0

config SOC_SERIES_BES2700
	select ARM
	select CPU_HAS_ARM_MPU
	select CPU_HAS_FPU
	select ARMV8_M_DSP
	select CPU_CORTEX_M_HAS_VTOR
	select CPU_CORTEX_M_HAS_SYSTICK
	select SOC_EARLY_INIT_HOOK
	select BUILD_OUTPUT_BIN
	select BUILD_OUTPUT_HEX

if SOC_SERIES_BES2700

config SOC_BES2700YP_CM55
	select CPU_CORTEX_M55
	select ARMV8_1_M_MVEI
	select ARMV8_1_M_MVEF
	select CPU_HAS_CUSTOM_FIXED_SOC_MPU_REGIONS

config SOC_BES2700YP_BTH
	select CPU_CORTEX_M33
	select SOC_EARLY_RESET_HOOK

endif # SOC_SERIES_BES2700
```

## bsp/soc/bestechnic/bes2700yp/Kconfig.defconfig
```kconfig
# SPDX-License-Identifier: Apache-2.0

if SOC_BES2700YP_CM55

config NUM_IRQS
	default 72

config SYS_CLOCK_HW_CYCLES_PER_SEC
	default $(dt_node_int_prop_int,/cpus/cpu@0,clock-frequency) if CORTEX_M_SYSTICK

config MAIN_STACK_SIZE
	default 2048

endif # SOC_BES2700YP_CM55

if SOC_BES2700YP_BTH

config NUM_IRQS
	default 64

config SYS_CLOCK_HW_CYCLES_PER_SEC
	default $(dt_node_int_prop_int,/cpus/cpu@0,clock-frequency) if CORTEX_M_SYSTICK

endif
```

## bsp/soc/bestechnic/bes2700yp/Kconfig.soc
```kconfig
# SPDX-License-Identifier: Apache-2.0

config SOC_FAMILY_BESTECHNIC_BES
	bool

config SOC_FAMILY
	default "bestechnic_bes" if SOC_FAMILY_BESTECHNIC_BES

config SOC_SERIES_BES2700
	bool
	select SOC_FAMILY_BESTECHNIC_BES

config SOC_SERIES
	default "bes2700" if SOC_SERIES_BES2700

config SOC_BES2700YP
	bool
	select SOC_SERIES_BES2700

config SOC_BES2700YP_CM55
	bool
	select SOC_BES2700YP

config SOC
	default "bes2700yp" if SOC_BES2700YP

config SOC_BES2700YP_BTH
	bool
	select SOC_BES2700YP
```

## west.yml
```yaml
manifest:
  version: "0.13"
  projects:
    - name: zephyr
      url: https://github.com/zephyrproject-rtos/zephyr
      revision: c64cf28f71f362e9c5efa389567f54a386e802dc
      west-commands: scripts/west-commands.yml
    - name: cmsis
      path: modules/hal/cmsis
      url: https://github.com/zephyrproject-rtos/cmsis
      revision: 512cc7e895e8491696b61f7ba8066b4a182569b8
    - name: cmsis_6
      path: modules/hal/cmsis_6
      url: https://github.com/zephyrproject-rtos/CMSIS_6
      revision: b2dfbe1a20bbd49c2d2c605073799671074bbb30
    - name: hal_bestechnic
      path: modules/hal/bestechnic
      url: https://github.com/zhxt/hal_bestechnic.git
      revision: 7e00feff5350c5b35b29660b28965be8b8bde607
  self:
    path: bestechnic-zephyr
```
